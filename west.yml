## west.yml
```yaml
manifest:
  version: "0.10"

  remotes:
    - name: ncs
      url-base: https://github.com/nrfconnect

  projects:
    - name: nrf
      repo-path: sdk-nrf
      revision: v1.6.1
      remote: ncs
      import:
        path-prefix: ncs
```
