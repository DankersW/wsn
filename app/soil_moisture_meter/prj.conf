## CMakeLists.txt
```
cmake_minimum_required(VERSION 3.8.2)

set(CMAKE_EXPORT_COMPILE_COMMANDS ON)

list(APPEND BOARD_ROOT /work)

find_package(Zephyr REQUIRED HINTS $ENV{ZEPHYR_BASE})
project(
	moisture_sensor
	VERSION "0.0.1"
	DESCRIPTION "Wireless sensor network to detect the soil moisture level"
	LANGUAGES CXX
)

target_sources(app PRIVATE
	src/main.c

	src/bt/mesh.c

	src/bt/models/model_definitions.c
	src/bt/models/led_handlers.c
	src/bt/models/attention_handlers.c
	src/bt/models/sensor_handlers.c

	src/ui/ui.c
	src/ui/led_driver.c

	src/sensors/chip_temp.c
)

target_include_directories(app PRIVATE 
	src
	src/bt
	src/bt/models
	src/ui
	src/sensors
)
```

## prj.conf
```kconfig
# General configuration
CONFIG_SYSTEM_WORKQUEUE_STACK_SIZE=2048
CONFIG_FLASH=y
CONFIG_FLASH_MAP=y
CONFIG_FCB=y
CONFIG_SETTINGS=y
CONFIG_HWINFO=y
CONFIG_PRINTK=y
CONFIG_DK_LIBRARY=y
CONFIG_BT_MESH_DK_PROV=y
CONFIG_GPIO=y

# USB
CONFIG_USB=y
CONFIG_USB_DEVICE_STACK=y
CONFIG_USB_DEVICE_MANUFACTURER="Dankers-iot"
CONFIG_USB_DEVICE_PRODUCT="Mesh Sensor"
CONFIG_USB_DEVICE_VID=0x1915
CONFIG_USB_DEVICE_PID=0x520F
CONFIG_USB_CDC_ACM=y
CONFIG_USB_UART_CONSOLE=y

# UART
CONFIG_SERIAL=y
CONFIG_UART_INTERRUPT_DRIVEN=y
CONFIG_UART_LINE_CTRL=y
CONFIG_UART_CONSOLE_ON_DEV_NAME="CDC_ACM_0"

# Bluetooth configuration
CONFIG_BT=y
CONFIG_BT_COMPANY_ID=0x0059
CONFIG_BT_DEVICE_NAME="Mesh soil moisture sensor"
CONFIG_BT_L2CAP_RX_MTU=69
CONFIG_BT_L2CAP_TX_MTU=69
CONFIG_BT_L2CAP_TX_BUF_COUNT=8
CONFIG_BT_LL_SW_SPLIT=y
CONFIG_BT_OBSERVER=y
CONFIG_BT_PERIPHERAL=y
CONFIG_BT_SETTINGS=y
CONFIG_BT_TINYCRYPT_ECC=y

# Disable unused Bluetooth features
CONFIG_BT_CTLR_DUP_FILTER_LEN=0
CONFIG_BT_CTLR_LE_ENC=n
CONFIG_BT_DATA_LEN_UPDATE=n
CONFIG_BT_PHY_UPDATE=n
CONFIG_BT_CTLR_CHAN_SEL_2=n
CONFIG_BT_CTLR_MIN_USED_CHAN=n
CONFIG_BT_CTLR_PRIVACY=n

# Bluetooth mesh configuration
CONFIG_BT_MESH=y
CONFIG_BT_MESH_RELAY=y
CONFIG_BT_MESH_FRIEND=y
CONFIG_BT_MESH_ADV_BUF_COUNT=13
CONFIG_BT_MESH_TX_SEG_MAX=10
CONFIG_BT_MESH_PB_GATT=y
CONFIG_BT_MESH_GATT_PROXY=y

# Bluetooth mesh models
CONFIG_BT_MESH_ONOFF_SRV=y
CONFIG_BT_MESH_SENSOR_SRV=y

# LOG
CONFIG_LOG=y
CONFIG_LOG_RUNTIME_FILTERING=y
CONFIG_LOG_BUFFER_SIZE=2048
CONFIG_LOG_PRINTK=y
CONFIG_LOG_PROCESS_TRIGGER_THRESHOLD=0
CONFIG_COVERAGE=n
CONFIG_LOG_BACKEND_FORMAT_TIMESTAMP=y

# Temperature sensor
CONFIG_SENSOR=y
CONFIG_TEMP_NRF5=y
```

## src/main.c
```c
#include <zephyr.h>
#include <device.h>
#include <usb/usb_device.h>
#include <logging/log.h>

#include "mesh.h"
#include "ui.h"

LOG_MODULE_REGISTER(wsn_node, LOG_LEVEL_DBG);

void init_node(void)
{
	usb_enable(NULL);
	enable_bt();

	enable_ui();
}

void main(void)
{
	init_node();

	while (1) {
		k_msleep(500);
		show_heartbeat();
	}
}
```

## src/gpio_definitions.h
```c
// LED 1 GREEN 
#define LED1_G_NODE DT_PATH(leds, led_0)
#define LED1	DT_GPIO_LABEL(LED1_G_NODE, gpios)
#define LED1_PIN	DT_GPIO_PIN(LED1_G_NODE, gpios)
#define LED1_FLAG	DT_GPIO_FLAGS(LED1_G_NODE, gpios)

// LED 2 RED 
#define LED2_R_NODE DT_PATH(leds, led_1)
#define LED2_R	DT_GPIO_LABEL(LED2_R_NODE, gpios)
#define LED2_PIN_R	DT_GPIO_PIN(LED2_R_NODE, gpios)
#define LED2_FLAG_R	DT_GPIO_FLAGS(LED2_R_NODE, gpios)

// LED 2 GREEN 
#define LED2_G_NODE DT_PATH(leds, led_2)
#define LED2_G	DT_GPIO_LABEL(LED2_G_NODE, gpios)
#define LED2_PIN_G	DT_GPIO_PIN(LED2_G_NODE, gpios)
#define LED2_FLAG_G	DT_GPIO_FLAGS(LED2_G_NODE, gpios)

// LED 2 BLUE 
#define LED2_B_NODE DT_PATH(leds, led_3)
#define LED2_B	DT_GPIO_LABEL(LED2_B_NODE, gpios)
#define LED2_PIN_B	DT_GPIO_PIN(LED2_B_NODE, gpios)
#define LED2_FLAG_B	DT_GPIO_FLAGS(LED2_B_NODE, gpios)
```
