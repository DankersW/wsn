## CMakeLists.txt
```
cmake_minimum_required(VERSION 3.10...3.19)

set(CMAKE_EXPORT_COMPILE_COMMANDS ON)

set(OVERLAY_CONFIG 
    "config/usb_overlay.conf config/shell_overlay.conf config/ot_overlay.conf"
)

find_package(Zephyr REQUIRED HINTS $ENV{ZEPHYR_BASE})

project(
	bt_gateway
	VERSION "0.0.1"
	DESCRIPTION "Thread gateway"
	LANGUAGES CXX
)

# TODO: Find out how to add subdirectories in Zephyr with CMake, cleaning up this code
target_sources(app PRIVATE 
	src/main.c
	src/cli/cli_shell.c
	src/cli/cli_definitions.c
	src/cli/handlers/misc_cmd_handlers.c
	src/cli/handlers/ot_cmd_handlers.c

	src/ot_coap/ot_coap.c
	src/ot_coap/ot_coap_utils.c

	src/protobuf/proto_deserializer.c

	../../home-automation-ipc/generated/nanopb/pb_common.c
    ../../home-automation-ipc/generated/nanopb/pb_decode.c
    ../../home-automation-ipc/generated/nanopb/pb_encode.c
    ../../home-automation-ipc/generated/nanopb/wsn.pb.c
)

target_include_directories(app PRIVATE 
	src/cli
	src/cli/handlers
	src/ot_coap
	src/protobuf

    ../../home-automation-ipc/generated/nanopb/
)
```

## prj.conf
```kconfig
# GENERAL
CONFIG_PRINTK=y
CONFIG_DK_LIBRARY=y

# GPIO
CONFIG_GPIO=y

# Floating point
CONFIG_FPU=y
CONFIG_FP_HARDABI=y

# Logging
CONFIG_LOG_STRDUP_MAX_STRING=100
CONFIG_LOG_STRDUP_BUF_COUNT=400
```

## src/main.c
```c
#include <zephyr.h>
#include <dk_buttons_and_leds.h>
#include <logging/log.h>

#include "cli_shell.h"
#include "ot_coap.h"

LOG_MODULE_REGISTER(main, LOG_LEVEL_DBG);

void main(void)
{
	int ret = dk_leds_init();
	if (ret) {
		LOG_ERR("Cannot init leds, (error: %d)", ret);
		return;
	}
	
	init_ot_coap();

	enable_shell();
}
```
