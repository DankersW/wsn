## CMakeLists.txt
```
cmake_minimum_required(VERSION 3.13.1)
find_package(Zephyr REQUIRED HINTS $ENV{ZEPHYR_BASE})
project(usb_shell)

target_sources(app PRIVATE src/main.c)
```

## prj.conf
```kconfig
# GENERAL
CONFIG_PRINTK=y
CONFIG_CBPRINTF_FP_SUPPORT=y

# GPIO
CONFIG_GPIO=y

# USB
CONFIG_USB=y
CONFIG_USB_DEVICE_STACK=y
CONFIG_USB_DEVICE_MANUFACTURER="Dankers-iot"
CONFIG_USB_DEVICE_PRODUCT="USB printer"
CONFIG_USB_DEVICE_VID=0x1915
CONFIG_USB_DEVICE_PID=0x520F
CONFIG_USB_CDC_ACM=y
CONFIG_USB_UART_CONSOLE=y

# UART
CONFIG_SERIAL=y
CONFIG_UART_INTERRUPT_DRIVEN=y
CONFIG_UART_LINE_CTRL=y
CONFIG_UART_CONSOLE_ON_DEV_NAME="CDC_ACM_0"

# LOG
CONFIG_LOG=y
CONFIG_LOG_RUNTIME_FILTERING=y
CONFIG_LOG_BUFFER_SIZE=2048
CONFIG_LOG_PRINTK=y
CONFIG_LOG_PROCESS_TRIGGER_THRESHOLD=0
CONFIG_COVERAGE=n
CONFIG_LOG_BACKEND_FORMAT_TIMESTAMP=y

# Temperature sensor
CONFIG_SENSOR=y
CONFIG_TEMP_NRF5=y
```

## src/main.c
```c
#include <zephyr.h>
#include <sys/printk.h>
#include <usb/usb_device.h>
#include <logging/log.h>
#include <drivers/sensor.h>

#define LOG_MODULE_NAME usb_print_example
LOG_MODULE_REGISTER(LOG_MODULE_NAME, LOG_LEVEL_DBG);

static const struct device *chip_dev;

void setup_chip_temp_sensor(void)
{
	chip_dev = device_get_binding(DT_PROP(DT_NODELABEL(temp), label));

	if (chip_dev == NULL) 
    {
		LOG_ERR("Could not initiate temperature sensor");
	} 
    else 
    {
		LOG_INF("Temperature sensor (%s) initiated", chip_dev->name);
	}
}


double get_chip_temp()
{
	sensor_sample_fetch(chip_dev);

	struct sensor_value temp_val;
	
	int err = sensor_channel_get(chip_dev, SENSOR_CHAN_DIE_TEMP, &temp_val);
	if (err) 
    {
		printk("Error getting temperature sensor data (%d)\n", err);
	}
	return temp_val.val1 + (temp_val.val2 * 0.000001);
}

void main(void)
{
	if (usb_enable(NULL)) {
		return;
	}

	k_sleep(K_SECONDS(3));
	
	setup_chip_temp_sensor();
	while (1) {
		k_sleep(K_SECONDS(2));
		double die_temp = get_chip_temp();
		printk("Die temperature: %f\n", die_temp);
	}
}
```
