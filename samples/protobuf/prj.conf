## CMakeLists.txt
```
cmake_minimum_required(VERSION 3.13.1)
find_package(Zephyr REQUIRED HINTS $ENV{ZEPHYR_BASE})
project(protobuf)

target_sources(app PRIVATE 
    src/main.c

    ../../home-automation-ipc/generated/nanopb/pb_common.c
    ../../home-automation-ipc/generated/nanopb/pb_decode.c
    ../../home-automation-ipc/generated/nanopb/pb_encode.c
    ../../home-automation-ipc/generated/nanopb/wsn.pb.c 
)

target_include_directories(app PRIVATE
    src
   ../../home-automation-ipc/generated/nanopb/
)
```

## prj.conf
```kconfig
# GENERAL
CONFIG_PRINTK=y
CONFIG_GPIO=y

# USB
CONFIG_USB=y
CONFIG_USB_DEVICE_STACK=y
CONFIG_USB_DEVICE_MANUFACTURER="Dankers-iot"
CONFIG_USB_DEVICE_PRODUCT="USB printer"
CONFIG_USB_DEVICE_VID=0x1915
CONFIG_USB_DEVICE_PID=0x520F
CONFIG_USB_CDC_ACM=y
CONFIG_USB_UART_CONSOLE=y

# UART
CONFIG_SERIAL=y
CONFIG_UART_INTERRUPT_DRIVEN=y
CONFIG_UART_LINE_CTRL=y
CONFIG_UART_CONSOLE_ON_DEV_NAME="CDC_ACM_0"

# LOG
CONFIG_LOG=y
CONFIG_LOG_RUNTIME_FILTERING=y
CONFIG_LOG_BUFFER_SIZE=2048
CONFIG_LOG_PRINTK=y
CONFIG_LOG_PROCESS_TRIGGER_THRESHOLD=0
CONFIG_COVERAGE=n
CONFIG_LOG_BACKEND_FORMAT_TIMESTAMP=y
CONFIG_LOG_STRDUP_MAX_STRING=100
```

## src/main.c
```c
#include <zephyr.h>
#include <sys/printk.h>
#include <usb/usb_device.h>
#include <logging/log.h>

#include <pb_encode.h>
#include <pb_decode.h>
#include "wsn.pb.h"

#include <stdio.h>
#include <string.h>


#define LOG_MODULE_NAME protobuf
LOG_MODULE_REGISTER(LOG_MODULE_NAME, LOG_LEVEL_DBG);

#define MSG_SIZE 128

void some_handler();
int proto_encode(uint8_t *msg);
void decode_to_console(uint8_t *msg, uint8_t size);
void bin2str(uint8_t *data, size_t size, char *buffer);


void main(void)
{
	if (usb_enable(NULL)) {
		return;
	}
	k_sleep(K_SECONDS(1));
	
	while (1) {
		k_sleep(K_SECONDS(2));

        some_handler();
	}
}

void some_handler()
{
    uint8_t buffer[128];
    int msg_size = proto_encode(buffer);
    printk("Message encoded successfully with a size: %d \n", msg_size);
    decode_to_console(buffer, msg_size);
}

int proto_encode(uint8_t *msg)
{
    wsn_SensorData message = wsn_SensorData_init_zero;
    pb_ostream_t stream = pb_ostream_from_buffer(msg, MSG_SIZE);
        
	message.temperature = 25;
	message.humidity = 17;
    strcpy(message.sensor_id,"S01");
        
    if (!pb_encode(&stream, wsn_SensorData_fields, &message))
    {
        printf("Encoding failed: %s\n", PB_GET_ERROR(&stream));
        return 1;
    }
    return stream.bytes_written;
}

void decode_to_console(uint8_t *msg, uint8_t size) 
{
    wsn_SensorData message = wsn_SensorData_init_zero;
    pb_istream_t stream = pb_istream_from_buffer(msg, size);
    if (!pb_decode(&stream, wsn_SensorData_fields, &message))
    {
        printf("Decoding failed: %s\n", PB_GET_ERROR(&stream));
        return;
    }

    char raw_buffer[100] = {};
    bin2str(msg, size, raw_buffer);

    LOG_INF("raw: %s", log_strdup(raw_buffer));
    LOG_INF("decoded: type %d, id %s, temp %d, humi %d", wsn_MessageType_SENSOR_DATA, log_strdup(message.sensor_id), message.temperature, message.humidity);
}

void bin2str(uint8_t *data, size_t size, char *buffer)
{
    for (int i=0; i<size; ++i){
        char tmp[4];
        sprintf(tmp, "%d ", data[i]);
        strcat(buffer, tmp);
    }
}
```

## src/simple.pb.h
```c
/* Automatically generated nanopb header */
/* Generated by nanopb-0.4.6-dev */

#ifndef PB_SIMPLE_PB_H_INCLUDED
#define PB_SIMPLE_PB_H_INCLUDED
#include <pb.h>

#if PB_PROTO_HEADER_VERSION != 40
#error Regenerate this file with the current version of nanopb generator.
#endif

/* Struct definitions */
typedef struct _SimpleMessage { 
    int32_t lucky_number; 
} SimpleMessage;


#ifdef __cplusplus
extern "C" {
#endif

/* Initializer values for message structs */
#define SimpleMessage_init_default               {0}
#define SimpleMessage_init_zero                  {0}

/* Field tags (for use in manual encoding/decoding) */
#define SimpleMessage_lucky_number_tag           1

/* Struct field encoding specification for nanopb */
#define SimpleMessage_FIELDLIST(X, a) \
X(a, STATIC,   REQUIRED, INT32,    lucky_number,      1)
#define SimpleMessage_CALLBACK NULL
#define SimpleMessage_DEFAULT NULL

extern const pb_msgdesc_t SimpleMessage_msg;

/* Defines for backwards compatibility with code written before nanopb-0.4.0 */
#define SimpleMessage_fields &SimpleMessage_msg

/* Maximum encoded size of messages (where known) */
#define SimpleMessage_size                       11

#ifdef __cplusplus
} /* extern "C" */
#endif

#endif
```
