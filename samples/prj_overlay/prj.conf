## CMakeLists.txt
```
cmake_minimum_required(VERSION 3.13.1)

set(OVERLAY_CONFIG 
    "config/usb_overlay.conf config/logging.conf"
)

find_package(Zephyr REQUIRED HINTS $ENV{ZEPHYR_BASE})
project(prj_overlay)

target_sources(app PRIVATE src/main.c)
```

## prj.conf
```kconfig
# GENERAL
CONFIG_PRINTK=y

# GPIO
CONFIG_GPIO=y
```

## src/main.c
```c
#include <zephyr.h>
#include <sys/printk.h>
#include <usb/usb_device.h>
#include <logging/log.h>

#define LOG_MODULE_NAME usb_print_example
LOG_MODULE_REGISTER(LOG_MODULE_NAME, LOG_LEVEL_DBG);

void main(void)
{
	if (usb_enable(NULL)) {
		return;
	}
	k_sleep(K_SECONDS(1));

	int counter = 0;
	while (1) {
		k_sleep(K_SECONDS(2));
		LOG_INF("Hello world %d", counter++);
	}
}
```
