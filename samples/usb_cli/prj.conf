## prj.conf
```kconfig
# GENERAL
CONFIG_PRINTK=y

# GPIO
CONFIG_GPIO=y

# USB
CONFIG_USB=y
CONFIG_USB_DEVICE_STACK=y
CONFIG_USB_DEVICE_MANUFACTURER="Vinnter AB"
CONFIG_USB_DEVICE_PRODUCT="CLI"
CONFIG_USB_DEVICE_VID=0x1915
CONFIG_USB_DEVICE_PID=0x520F
CONFIG_USB_CDC_ACM=y
CONFIG_USB_UART_CONSOLE=y
CONFIG_SHELL_BACKEND_SERIAL_INIT_PRIORITY=51

# UART
CONFIG_SERIAL=y
CONFIG_UART_INTERRUPT_DRIVEN=y
CONFIG_UART_LINE_CTRL=y
CONFIG_UART_CONSOLE_ON_DEV_NAME="CDC_ACM_0"
CONFIG_UART_SHELL_ON_DEV_NAME="CDC_ACM_0"

# SHELL
CONFIG_SHELL=y
CONFIG_KERNEL_SHELL=y
CONFIG_SHELL_BACKEND_SERIAL=y
CONFIG_THREAD_MONITOR=y
CONFIG_INIT_STACKS=y
CONFIG_BOOT_BANNER=y
CONFIG_THREAD_NAME=y
CONFIG_LOG=y
CONFIG_SHELL_HISTORY=y
CONFIG_SHELL_STACK_SIZE=1024
CONFIG_SHELL_CMD_BUFF_SIZE=128
CONFIG_SHELL_WILDCARD=n
CONFIG_SHELL_VT100_COLORS=y
CONFIG_SHELL_HELP_ON_WRONG_ARGUMENT_COUNT=y
CONFIG_SHELL_STATS=y
CONFIG_SHELL_CMDS=y
CONFIG_SHELL_HELP=y
CONFIG_SHELL_TAB=y
CONFIG_SHELL_METAKEYS=n
CONFIG_SHELL_LOG_BACKEND=n
CONFIG_KERNEL_SHELL=y
CONFIG_DEVICE_SHELL=y
CONFIG_DATE_SHELL=n
CONFIG_CBPRINTF_NANO=y
CONFIG_SENSOR_SHELL=n
```

## src/main.c
```c
#include <zephyr.h>
#include <sys/printk.h>
#include <shell/shell.h>
#include <logging/log.h>
#include <stdlib.h>

#include <usb/usb_device.h>
#include <drivers/uart.h>


LOG_MODULE_REGISTER(cdc_acm_echo, LOG_LEVEL_INF);


static int cmd_demo_ping(const struct shell *shell, size_t argc, char **argv)
{
	ARG_UNUSED(argc);
	ARG_UNUSED(argv);
	shell_print(shell, "pong");
	return 0;
}

static int cmd_dict(const struct shell *shell, size_t argc, char **argv, void *data)
{
	int val = (intptr_t)data;
	shell_print(shell, "(syntax, value) : (%s, %d)", argv[0], val);
	return 0;
}

SHELL_SUBCMD_DICT_SET_CREATE(sub_dict_cmds, cmd_dict,
	(value_0, 0), (value_1, 1), (value_2, 2), (value_3, 3)
);

SHELL_STATIC_SUBCMD_SET_CREATE(sub_demo,
	SHELL_CMD(dictionary, &sub_dict_cmds, "Dictionary commands", NULL),
	SHELL_CMD(ping, NULL, "Ping command.", cmd_demo_ping),
	SHELL_SUBCMD_SET_END /* Array terminated. */
);
SHELL_CMD_REGISTER(demo, &sub_demo, "Demo commands", NULL);

void main(void)
{
	if (usb_enable(NULL)) {
		return;
	}

	const struct device *dev = device_get_binding(CONFIG_UART_CONSOLE_ON_DEV_NAME);
	uint32_t dtr = 0;
	while (!dtr) {
		uart_line_ctrl_get(dev, UART_LINE_CTRL_DTR, &dtr);
	}

	if (strlen(CONFIG_UART_CONSOLE_ON_DEV_NAME) != strlen("CDC_ACM_0") ||
	    strncmp(CONFIG_UART_CONSOLE_ON_DEV_NAME, "CDC_ACM_0",
		    strlen(CONFIG_UART_CONSOLE_ON_DEV_NAME))) {
		printk("Error: Console device name is not USB ACM\n");

		return;
	}

	printk("All ready to roll...");
	while (1) {
		k_sleep(K_SECONDS(0.1));
	}
	
}
```
